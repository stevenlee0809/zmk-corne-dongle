## config/west.yml
```yaml
manifest:
  remotes:
    - name: zmkfirmware
      url-base: https://github.com/zmkfirmware
    - name: m165437 #new entry
      url-base: https://github.com/M165437 #new entry
    - name: tokyo2006
      url-base: https://github.com/tokyo2006
    - name: englmaxi
      url-base: https://github.com/englmaxi
  projects:
    - name: nice-view-gem #new entry
      remote: m165437 #new entry
      revision: v0.3.0 #new entry
    - name: zmk
      remote: zmkfirmware
      revision: c25e927a2fae915e208a8777ce211a10c658e771
      import: app/west.yml
    - name: prospector-zmk-module                 # <--- and these
      remote: tokyo2006                          # <---
      revision: change_spi2
    - name: zmk-dongle-display
      remote: englmaxi
      revision: 34c8852e6dc4116f8996b0fdb2b03b9d62cdfa03
  self:
    path: config
```
